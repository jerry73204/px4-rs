## examples/gyro_watch/Kconfig
```kconfig
menuconfig MODULES_GYRO_WATCH
	bool "gyro_watch (Rust example)"
	default n
	---help---
		Phase-08 demo: subscribes to sensor_gyro on rate_ctrl,
		looks for high-magnitude samples, and publishes a
		GyroAlert each time a spike crosses the threshold.
```

## examples/heartbeat/Kconfig
```kconfig
menuconfig MODULES_HEARTBEAT
	bool "heartbeat (Rust example)"
	default n
	---help---
		Demonstration Rust PX4 module: publishes Airspeed messages
		in a tight loop. Used as the phase-07 end-to-end smoke test.
```

## examples/hello_module/Kconfig
```kconfig
menuconfig MODULES_HELLO_MODULE
	bool "hello_module (Rust example)"
	default n
	---help---
		Phase-08 demo: one #[task] on lp_default that prints a
		"hello" line once a second using px4_workqueue::sleep.
```

## examples/multi_task/Kconfig
```kconfig
menuconfig MODULES_MULTI_TASK
	bool "multi_task (Rust example)"
	default n
	---help---
		Phase-08 demo: two #[task]s on different WorkQueues —
		a producer on hp_default and a consumer on lp_default —
		exchange wake-ups via px4_workqueue::Notify.
```

## examples/px4-rust-template/Kconfig
```kconfig
menuconfig MODULES_PX4_RUST_TEMPLATE
	bool "px4_rust_template (Rust skeleton)"
	default n
	---help---
		Skeleton PX4 module written in Rust. Spawns one task that
		logs a hello message. Use as a starting point for your own
		Rust modules.
```

## tests/sitl/px4-externals/src/modules/e2e_multi_wq/Kconfig
```kconfig
menuconfig MODULES_E2E_MULTI_WQ
	bool "e2e_multi_wq (px4-rs phase-11 multi-WQ test)"
	default y
	---help---
		Phase-11 SITL test module. Two #[task] entries pinned
		to different WorkQueues (`lp_default` and `hp_default`)
		each emit their own log banner, demonstrating that the
		runtime really does dispatch into multiple WQ threads.
```

## tests/sitl/px4-externals/src/modules/e2e_panic/Kconfig
```kconfig
menuconfig MODULES_E2E_PANIC
	bool "e2e_panic (px4-rs phase-11 panic test)"
	default y
	---help---
		Phase-11 SITL test module. On `start`, spawns a task
		that panics on first poll, exercising the
		px4_log::panic_handler!() install path. Pulled in only
		by the tests/sitl/ external-modules tree.
```

## tests/sitl/px4-externals/src/modules/e2e_pubsub_pub/Kconfig
```kconfig
menuconfig MODULES_E2E_PUBSUB_PUB
	bool "e2e_pubsub_pub (px4-rs phase-11 pub/sub publisher)"
	default y
	---help---
		Phase-11 SITL test module. Publishes an incrementing
		E2ePubsub topic each iteration of one #[task]. Pulled in
		only by the tests/sitl/ external-modules tree.
```

## tests/sitl/px4-externals/src/modules/e2e_pubsub_sub/Kconfig
```kconfig
menuconfig MODULES_E2E_PUBSUB_SUB
	bool "e2e_pubsub_sub (px4-rs phase-11 pub/sub subscriber)"
	default y
	---help---
		Phase-11 SITL test module. Subscribes to the E2ePubsub
		topic published by e2e_pubsub_pub and logs each received
		sample. Pulled in only by the tests/sitl/ external-modules
		tree.
```

## tests/sitl/px4-externals/src/modules/e2e_smoke/Kconfig
```kconfig
menuconfig MODULES_E2E_SMOKE
	bool "e2e_smoke (px4-rs phase-11 smoke test)"
	default y
	---help---
		Phase-11 SITL test module. Spawns one task that publishes
		Airspeed in a tight loop. Pulled in only by the
		tests/sitl/ external-modules tree.
```
